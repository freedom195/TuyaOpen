## boards/L511C/Kconfig
```kconfig
# Ktuyaconf
config PLATFORM_CHOICE
    string
    default "L511C"

config OPERATING_SYSTEM
    int
    default 98
    ---help---
        100     /* LINUX */
        98      /* RTOS */
        3       /* Non-OS */

rsource "./TKL_Kconfig"
rsource "./OS_SERVICE_Kconfig"

choice
    prompt "Choice a board"

    config BOARD_CHOICE_default
        bool "default"
        if (BOARD_CHOICE_default)
            rsource "./default/Kconfig"
        endif

# <new-board-add: This line cannot be deleted or modified>

endchoice
```

## boards/L511C/default/Kconfig
```kconfig
config CHIP_CHOICE
    string
    default "L511C"

config BOARD_CHOICE
    string
    default "default"

config BOARD_CONFIG
    bool
    default y
```
